## CMakeLists.txt
```
cmake_minimum_required(VERSION 3.20.0)
find_package(Zephyr REQUIRED HINTS $ENV{ZEPHYR_BASE})
project(mixed_criticality)

target_sources(app PRIVATE src/main.c src/critical.c src/background.c)

# Relocate background.c to RAM (DRAM)
# Default code placement is in FLASH (SRAM) due to zephyr,flash = &ram0
# We move non-critical code to RAM (DRAM)
zephyr_code_relocate(FILES src/background.c LOCATION RAM)
```

## prj.conf
```kconfig
CONFIG_PRINTK=y
CONFIG_CODE_DATA_RELOCATION=y
CONFIG_XIP=y
```

## src/main.c
```c
/*
 * Copyright (c) 2024 gem5
 *
 * SPDX-License-Identifier: Apache-2.0
 */

#include <zephyr/kernel.h>
#include <zephyr/sys/printk.h>

/* Thread Priorities */
#define CRITICAL_PRIORITY -1
#define BACKGROUND_PRIORITY 0

/* Stack Sizes */
#define STACK_SIZE 1024

/* External Functions */
extern void critical_task(void);
extern void background_task(void);

/* Thread Stacks */
K_THREAD_STACK_DEFINE(critical_stack, STACK_SIZE);
K_THREAD_STACK_DEFINE(background_stack, STACK_SIZE);

/* Thread Data */
struct k_thread critical_thread_data;
struct k_thread background_thread_data;

/* Entry Points */
void critical_entry(void *p1, void *p2, void *p3)
{
    critical_task();
}

void background_entry(void *p1, void *p2, void *p3)
{
    background_task();
}

int main(void)
{
    printk("Gem5 RISC-V Mixed Criticality Workload Starting...\n");

    /* Spawn Critical Thread */
    k_thread_create(&critical_thread_data, critical_stack,
                    K_THREAD_STACK_SIZEOF(critical_stack),
                    critical_entry, NULL, NULL, NULL,
                    CRITICAL_PRIORITY, 0, K_NO_WAIT);

    /* Spawn Background Thread */
    k_thread_create(&background_thread_data, background_stack,
                    K_THREAD_STACK_SIZEOF(background_stack),
                    background_entry, NULL, NULL, NULL,
                    BACKGROUND_PRIORITY, 0, K_NO_WAIT);

    return 0;
}
```

## src/background.c
```c
/*
 * Copyright (c) 2024 gem5
 *
 * SPDX-License-Identifier: Apache-2.0
 */

#include <zephyr/kernel.h>
#include <zephyr/sys/printk.h>

void background_task(void)
{
    int count = 0;
    while (1) {
        /* Simulate background processing */
        /* This code should reside in DRAM (0x80200000) */
        printk("Background Task: %d (DRAM)\n", count++);
        k_msleep(500); /* 2Hz */
    }
}
```

## src/critical.c
```c
/*
 * Copyright (c) 2024 gem5
 *
 * SPDX-License-Identifier: Apache-2.0
 */

#include <zephyr/kernel.h>
#include <zephyr/sys/printk.h>

void critical_task(void)
{
    int count = 0;
    while (1) {
        /* Simulate critical processing */
        /* This code should reside in SRAM (0x80000000) */
        printk("Critical Task: %d (SRAM)\n", count++);
        k_msleep(100); /* 10Hz */
    }
}
```

## boards/gem5/Kconfig
```kconfig
# Copyright (c) 2024 gem5 RISC-V RT Project
# SPDX-License-Identifier: Apache-2.0

rsource "*/Kconfig.$(BOARD)"
```

## boards/gem5/riscv32/Kconfig.defconfig
```kconfig
# Copyright (c) 2024 gem5 RISC-V RT Project
# SPDX-License-Identifier: Apache-2.0

if BOARD_GEM5_RISCV32

config BOARD
	default "gem5_riscv32"

config BUILD_OUTPUT_BIN
	default n

endif # BOARD_GEM5_RISCV32
```

## boards/gem5/riscv32/Kconfig.gem5_riscv32
```kconfig
# Copyright (c) 2024 gem5 RISC-V RT Project
# SPDX-License-Identifier: Apache-2.0

config BOARD_GEM5_RISCV32
	bool "gem5 RISC-V 32-bit"
	select SOC_QEMU_VIRT_RISCV32
```

## boards/gem5/riscv32/board.yml
```yaml
board:
  name: gem5_riscv32
  full_name: gem5 RISC-V 32-bit Full-System Simulation
  vendor: gem5
  socs:
    - name: qemu_virt_riscv32
```

## boards/gem5/riscv32/gem5_riscv32_defconfig
```kconfig
# SPDX-License-Identifier: Apache-2.0

CONFIG_CONSOLE=y
CONFIG_SERIAL=y
CONFIG_UART_CONSOLE=y
CONFIG_XIP=n
CONFIG_GEN_SW_ISR_TABLE=y
```

## boards/gem5/riscv32_sram/Kconfig.defconfig
```kconfig
# Copyright (c) 2024 gem5 RISC-V RT Project
# SPDX-License-Identifier: Apache-2.0

if BOARD_GEM5_RISCV32_SRAM

config BOARD
	default "gem5_riscv32_sram"

config BUILD_OUTPUT_BIN
	default n

endif # BOARD_GEM5_RISCV32_SRAM
```

## boards/gem5/riscv32_sram/Kconfig.gem5_riscv32_sram
```kconfig
# Copyright (c) 2024 gem5 RISC-V RT Project
# SPDX-License-Identifier: Apache-2.0

config BOARD_GEM5_RISCV32_SRAM
	bool "gem5 RISC-V 32-bit SRAM"
	select SOC_QEMU_VIRT_RISCV32
```

## boards/gem5/riscv32_sram/board.yml
```yaml
board:
  name: gem5_riscv32_sram
  full_name: gem5 RISC-V 32-bit SRAM
  vendor: gem5
  socs:
    - name: qemu_virt_riscv32
```

## boards/riscv/gem5_riscv32/Kconfig.board
```kconfig
config BOARD_GEM5_RISCV32
	bool "gem5 RISC-V 32-bit"
	depends on SOC_RISCV_VIRT
	select RISCV_ISA_RV32I
	select RISCV_ISA_EXT_M
	select RISCV_ISA_EXT_A
	select RISCV_ISA_EXT_C
```

## boards/riscv/gem5_riscv32/Kconfig.defconfig
```kconfig
if BOARD_GEM5_RISCV32

config BOARD
	default "gem5_riscv32"

config SYS_CLOCK_HW_CYCLES_PER_SEC
	default 10000000

endif # BOARD_GEM5_RISCV32
```

## boards/riscv/gem5_riscv_rt/Kconfig.board
```kconfig
config BOARD_GEM5_RISCV_RT
	bool "gem5 RISC-V RT Board"
	depends on SOC_RISCV_SIFIVE_FREEDOM
```

## boards/riscv/gem5_riscv_rt/Kconfig.defconfig
```kconfig
if BOARD_GEM5_RISCV_RT

config BOARD
	default "gem5_riscv_rt"

config SYS_CLOCK_HW_CYCLES_PER_SEC
	default 100000000

endif # BOARD_GEM5_RISCV_RT
```

## src/zephyr_apps/hello_world/build_core1/Kconfig/boards/Kconfig
```kconfig
# Load Zephyr board Kconfig descriptions.
osource "/home/ubuntu/work/gem5/gem5_riscv_rt/src/zephyr/zephyr/boards/sifive/hifive1/Kconfig"
```

## src/zephyr_apps/hello_world/build_core3/Kconfig/arch/Kconfig
```kconfig
# Load Zephyr Arch Kconfig descriptions.
osource "/home/ubuntu/work/gem5/gem5_riscv_rt/src/zephyr/zephyr/arch/rx/Kconfig"
osource "/home/ubuntu/work/gem5/gem5_riscv_rt/src/zephyr/zephyr/arch/x86/Kconfig"
osource "/home/ubuntu/work/gem5/gem5_riscv_rt/src/zephyr/zephyr/arch/xtensa/Kconfig"
osource "/home/ubuntu/work/gem5/gem5_riscv_rt/src/zephyr/zephyr/arch/sparc/Kconfig"
osource "/home/ubuntu/work/gem5/gem5_riscv_rt/src/zephyr/zephyr/arch/riscv/Kconfig"
osource "/home/ubuntu/work/gem5/gem5_riscv_rt/src/zephyr/zephyr/arch/posix/Kconfig"
osource "/home/ubuntu/work/gem5/gem5_riscv_rt/src/zephyr/zephyr/arch/mips/Kconfig"
osource "/home/ubuntu/work/gem5/gem5_riscv_rt/src/zephyr/zephyr/arch/arm64/Kconfig"
osource "/home/ubuntu/work/gem5/gem5_riscv_rt/src/zephyr/zephyr/arch/arm/Kconfig"
osource "/home/ubuntu/work/gem5/gem5_riscv_rt/src/zephyr/zephyr/arch/arc/Kconfig"
```

## src/zephyr_apps/hello_world/build_core3/Kconfig/boards/Kconfig.defconfig
```kconfig
# Load Zephyr board defconfig descriptions.
osource "/home/ubuntu/work/gem5/gem5_riscv_rt/src/zephyr/zephyr/boards/sifive/hifive1/Kconfig.defconfig"
```

## src/zephyr_apps/smp_synchronization/boards/riscv/gem5_octa/Kconfig.board
```kconfig
config BOARD_GEM5_OCTA
	bool "gem5 Octa-Core Board"
	select SOC_SIFIVE_FREEDOM_FE310_G000
```

## src/zephyr_apps/smp_synchronization/boards/riscv/gem5_octa/Kconfig.defconfig
```kconfig
if BOARD_GEM5_OCTA

config BOARD
	default "gem5_octa"

config SYS_CLOCK_HW_CYCLES_PER_SEC
	default 100000000

config RISCV_HAS_CPU_IDLE
	default y

config NUM_IRQS
	default 52

endif # BOARD_GEM5_OCTA
```
